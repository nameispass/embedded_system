## Kconfig.projbuild
```kconfig
menu "Temperature Monitor Configuration"

    config DHT_GPIO
        int "DHT22 GPIO number"
        range 0 21
        default 4
        help
            GPIO number for DHT22 data pin.

    config BUZZER_GPIO
        int "Buzzer GPIO number"
        range 0 21
        default 5
        help
            GPIO number for Buzzer control.

    config LED_GPIO
        int "LED GPIO number"
        range 0 21
        default 2
        help
            GPIO number for LED indicator.

    config I2C_SDA_GPIO
        int "I2C SDA GPIO number"
        range 0 21
        default 8
        help
            GPIO number for I2C SDA (OLED).

    config I2C_SCL_GPIO
        int "I2C SCL GPIO number"
        range 0 21
        default 9
        help
            GPIO number for I2C SCL (OLED).

    config TEMP_WARNING_THRESHOLD
        int "Warning temperature threshold (Celsius)"
        range 20 60
        default 35
        help
            Temperature threshold for warning state.

    config TEMP_OVERHEAT_THRESHOLD
        int "Overheat temperature threshold (Celsius)"
        range 30 80
        default 45
        help
            Temperature threshold for overheat state.

endmenu
```

## sdkconfig.defaults
```kconfig
# ESP-IDF SDK Configuration Defaults
# Temperature Monitor System

# FreeRTOS Configuration
CONFIG_FREERTOS_HZ=1000
CONFIG_FREERTOS_UNICORE=y
CONFIG_FREERTOS_USE_TRACE_FACILITY=y
CONFIG_FREERTOS_USE_STATS_FORMATTING_FUNCTIONS=y
CONFIG_FREERTOS_VTASKLIST_INCLUDE_COREID=y
CONFIG_FREERTOS_GENERATE_RUN_TIME_STATS=y

# ESP System Configuration
CONFIG_ESP_SYSTEM_EVENT_QUEUE_SIZE=32
CONFIG_ESP_SYSTEM_EVENT_TASK_STACK_SIZE=2304
CONFIG_ESP_MAIN_TASK_STACK_SIZE=4096

# Log Configuration
CONFIG_LOG_DEFAULT_LEVEL_INFO=y
CONFIG_LOG_DEFAULT_LEVEL=3
CONFIG_LOG_MAXIMUM_LEVEL=5

# I2C Configuration
CONFIG_I2C_ENABLE_DEBUG_LOG=n

# GPIO Configuration
CONFIG_GPIO_ESP32_SUPPORT_SWITCH_SLP_PULL=y

# Watchdog Configuration
CONFIG_ESP_TASK_WDT=y
CONFIG_ESP_TASK_WDT_TIMEOUT_S=10
CONFIG_ESP_TASK_WDT_CHECK_IDLE_TASK_CPU0=y

# Memory Configuration
CONFIG_ESP_SYSTEM_ALLOW_RTC_FAST_MEM_AS_HEAP=y
```
